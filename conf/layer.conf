## conf/layer.conf
```bitbake
# We have a conf and classes directory, add to BBPATH
BBPATH .= ":${LAYERDIR}"

# We have recipes-* directories, add to BBFILES
BBFILES += "${LAYERDIR}/recipes-*/*/*.bb \
            ${LAYERDIR}/recipes-*/*/*.bbappend"

BBFILE_COLLECTIONS += "avt-toradex-layer"
BBFILE_PATTERN_avt-toradex-layer = "^${LAYERDIR}/"
BBFILE_PRIORITY_avt-toradex-layer = "6"

LAYERDEPENDS_avt-toradex-layer = "core alvium-avt-layer toradex-nxp-layer"
LAYERSERIES_COMPAT_avt-toradex-layer = "scarthgap"
```
